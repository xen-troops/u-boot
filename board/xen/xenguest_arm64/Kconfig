## board/xen/xenguest_arm64/Kconfig
```kconfig
if TARGET_XENGUEST_ARM64

config SYS_BOARD
	default "xenguest_arm64"

config SYS_VENDOR
	default "xen"

config SYS_CONFIG_NAME
	default "xenguest_arm64"

config NEED_XEN_PARAMS
	bool "Need to have a code to save registers as a boot params"
	default y

config LNX_KRNL_IMG_TEXT_OFFSET_BASE
	default 0x80000000

endif
```

## board/xen/xenguest_arm64_android/Kconfig
```kconfig
if TARGET_XENGUEST_ARM64_ANDROID

config SYS_BOARD
	default "xenguest_arm64_android"

config SYS_VENDOR
	default "xen"

config SYS_CONFIG_NAME
	default "xenguest_arm64_android"

endif
```

## configs/xenguest_arm64_android_defconfig
```kconfig
CONFIG_ARM=y
CONFIG_POSITION_INDEPENDENT=y
CONFIG_SYS_TEXT_BASE=0x40080000
CONFIG_SYS_MALLOC_F_LEN=0x2000
CONFIG_IDENT_STRING=" xenguest"
CONFIG_TARGET_XENGUEST_ARM64_ANDROID=y
CONFIG_BOOTDELAY=3
CONFIG_ANDROID_BOOT_IMAGE=y
CONFIG_FASTBOOT_BUF_ADDR=0x82000000
CONFIG_FASTBOOT_BUF_SIZE=0x2F000000

CONFIG_PARTITIONS=y
CONFIG_MMC=y
CONFIG_CMD_BCB=y

CONFIG_ANDROID_AB=y
CONFIG_CMD_AB_SELECT=y

CONFIG_LIBAVB=y
CONFIG_AVB_VERIFY=y
CONFIG_CMD_AVB=y
CONFIG_PARTITION_UUIDS=y
CONFIG_FASTBOOT=y
CONFIG_UDP_FUNCTION_FASTBOOT=y
CONFIG_NET=y
CONFIG_CMD_NET=y
CONFIG_CMD_BOOTP=y

CONFIG_HUSH_PARSER=y
CONFIG_CMD_PART=y


CONFIG_SYS_PROMPT="xenguest# "

CONFIG_CMD_BDI=n
CONFIG_CMD_BOOTD=n
CONFIG_CMD_BOOTEFI=n
CONFIG_CMD_BOOTEFI_HELLO_COMPILE=n
CONFIG_CMD_ELF=n
CONFIG_CMD_EXT4=y
CONFIG_CMD_FAT=y
CONFIG_CMD_GO=n
CONFIG_CMD_RUN=n
CONFIG_CMD_IMI=n
CONFIG_CMD_IMLS=n
CONFIG_CMD_XIMG=n
CONFIG_CMD_EXPORTENV=n
CONFIG_CMD_IMPORTENV=n
CONFIG_CMD_EDITENV=n
CONFIG_CMD_ENV_EXISTS=n
CONFIG_CMD_MEMORY=y
CONFIG_CMD_CRC32=n
CONFIG_CMD_DM=n
CONFIG_CMD_LOADB=n
CONFIG_CMD_LOADS=n
CONFIG_CMD_FLASH=n
CONFIG_CMD_GPT=y
CONFIG_CMD_FPGA=n
CONFIG_CMD_ECHO=y
CONFIG_CMD_ITEST=n
CONFIG_CMD_SOURCE=n
CONFIG_CMD_SETEXPR=n
CONFIG_CMD_MISC=n
CONFIG_CMD_UNZIP=n
CONFIG_CMD_LZMADEC=n
CONFIG_CMD_SAVEENV=n
CONFIG_CMD_UMS=n

CONFIG_CMD_PVBLOCK=y
CONFIG_CMD_MMC=y

#CONFIG_USB=n
# CONFIG_ISO_PARTITION is not set

CONFIG_EFI_PARTITION=y
# CONFIG_EFI_LOADER is not set

CONFIG_DM=y
CONFIG_DM_SERIAL=y
CONFIG_DM_MMC=y
# CONFIG_REQUIRE_SERIAL_CONSOLE is not set

CONFIG_OF_BOARD=y
CONFIG_OF_LIBFDT=y
```

## drivers/tee/optee/Kconfig
```kconfig
# OP-TEE Trusted Execution Environment Configuration
config OPTEE
	bool "OP-TEE"
	depends on ARM_SMCCC
	help
	  This implements the OP-TEE Trusted Execution Environment (TEE)
	  driver. OP-TEE is a Trusted OS designed primarily to rely on the
	  ARM TrustZone(R) technology as the underlying hardware isolation
	  mechanism. This driver can request services from OP-TEE, but also
	  handle Remote Procedure Calls (RPC) from OP-TEE needed to
	  execute a service. For more information see: https://www.op-tee.org

if OPTEE || SANDBOX

menu "OP-TEE options"

config OPTEE_TA_AVB
	bool "Support AVB TA"
	default y
	help
	  Enables support for the AVB Trusted Application (TA) in OP-TEE.
	  The TA can support the "avb" subcommands "read_rb", "write"rb"
	  and "is_unlocked".

config OPTEE_RPMB_EMUL
       bool "Support RPMB emulation for OP-TEE"
       default n
       depends on !SUPPORT_EMMC_RPMB
       help
         Enables emulation of RPMB partiotion, using GPT partitoion
	 named "RPMBEMUL" on pvblock device

config OPTEE_ENABLE_RPMB
       bool "Enable RPMB support for OP-TEE supplicant"
       depends on OPTEE_RPMB_EMUL || SUPPORT_EMMC_RPMB
       default y

endmenu

endif
```
